## conf/layer.conf
```bitbake
# We have a conf and classes directory, append to BBPATH
BBPATH .= ":${LAYERDIR}"

# We have a recipes directory, add to BBFILES
BBFILES += "${LAYERDIR}/recipes*/*/*.bb ${LAYERDIR}/recipes*/*/*.bbappend"

BBFILE_COLLECTIONS += "meta-old-gcc"
BBFILE_PATTERN_meta-old-gcc := "^${LAYERDIR}/"
BBFILE_PRIORITY_meta-old-gcc = "6"

# We're good with rocko, not that it's checking for this...sumo and beyond is...
LAYERVERSION_meta-old-gcc = "1"
LAYERDEPENDS_meta-old-gcc = "core"
LAYERSERIES_COMPAT_meta-old-gcc = "warrior zeus dunfell gatesgarth hardknott honister"
```

## conf/machine/include/use-gcc-7.x.inc
```bitbake
# Tell Yocto that we explictly want it to use GCC 7.x here...
GCCVERSION = "7.%"

# Technically, since the layer provides an older BINUTILS to work with
# we're going to force this as well...
BINUVERSION = "2.30%"

# This is specifically needed to make *ANY* GCC version 7.x or prior compiler 
# build with Warrior and beyond right.
DEBUG_PREFIX_MAP_remove = "-fmacro-prefix-map=${WORKDIR}=/usr/src/debug/${PN}/${EXTENDPE}${PV}-${PR}"
BUILD_LDFLAGS_remove = "-Wl,--enable-new-dtags"
```

## conf/machine/include/use-gcc-8.x.inc
```bitbake
# Tell Yocto that we explictly want it to use GCC 8.x here...
GCCVERSION = "8.%"

# Technically, since the layer provides an older BINUTILS to work with
# we're going to force this as well...
BINUVERSION = "2.30%"
```
